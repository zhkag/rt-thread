## bsp/stm32/stm32h7R7-artpi2/Kconfig
```kconfig
mainmenu "RT-Thread Configuration"

config BSP_DIR
    string
    option env="BSP_ROOT"
    default "."

config RTT_DIR
    string
    option env="RTT_ROOT"
    default "rt-thread"

config PKGS_DIR
    string
    option env="PKGS_ROOT"
    default "packages"

source "$(RTT_DIR)/Kconfig"
osource "$PKGS_DIR/Kconfig"
rsource "../libraries/Kconfig"

config RT_STUDIO_BUILT_IN
    bool
    select ARCH_ARM_CORTEX_M7
    select RT_USING_COMPONENTS_INIT
    select RT_USING_USER_MAIN
    default y


if !RT_USING_NANO
rsource "board/Kconfig"
endif
```
